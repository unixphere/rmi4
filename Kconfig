## Kconfig
```kconfig
#
# RMI4 configuration
#
config RMI4_BUS
	tristate "Synaptics RMI4 bus support"
	help
	  Say Y here if you want to support the Synaptics RMI4 bus.

	  If unsure, say Y.

	  To compile this driver as a module, choose M here: the
	  module will be called rmi-bus.

config RMI4_I2C
	tristate "RMI4 I2C Support"
	depends on RMI4_BUS && I2C
	help
	  Say Y here if you want to support RMI4 devices connected to an I2C
	  bus.

	  If unsure, say Y.

	  To compile this driver as a module, choose M here: the
	  module will be called rmi-i2c.

config RMI4_SPI
	tristate "RMI4 SPI Support"
	depends on RMI4_BUS && SPI
	help
	  Say Y here if you want to support RMI4 devices connected to an SPI
	  bus.

	  To compile this driver as a module, choose M here: the
	  module will be called rmi-spi.

config RMI4_GENERIC
	tristate "RMI4 Generic driver"
	depends on RMI4_BUS
	help
	  Say Y here if you want to support generic RMI4 devices.

	  To compile this driver as a module, choose M here: the
	  module will be called rmi-generic.

config RMI4_F11
	tristate "RMI4 Function 11"
	depends on RMI4_BUS
	help
	  Say Y here if you want to add support for RMI4 function 11.

	  This extends any RMI4 device driver that needs it with the
	  functionality contained in the specific RMI function.

	  To compile this driver as a module, choose M here: the
	  module will be called rmi-f11.
```
